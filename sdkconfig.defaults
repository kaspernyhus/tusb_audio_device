## sdkconfig.defaults
```kconfig
#
# ESP Signal Generator
#
CONFIG_ENABLE_ESP_SIGNAL_GENERATOR=y
CONFIG_ESP_SIG_GEN_DEF_SAMPLE_RATE=48000
CONFIG_ESP_SIG_GEN_CHANNELS=2
CONFIG_ESP_SIG_GEN_DEF_VOLUME=80
# CONFIG_ESP_SIG_GEN_SINE is not set
CONFIG_ESP_SIG_GEN_SINE_TAB=y
# CONFIG_ESP_SIG_GEN_PINK_NOISE is not set
# CONFIG_ESP_SIG_GEN_SILENCE is not set
CONFIG_ESP_SIG_GEN_DEF_FREQ=440
# CONFIG_ESP_SIG_GEN_16 is not set
CONFIG_ESP_SIG_GEN_24=y
# CONFIG_ESP_SIG_GEN_24_32 is not set
# CONFIG_ESP_SIG_GEN_32 is not set
CONFIG_ESP_SIG_GEN_LE=y
# CONFIG_ESP_SIG_GEN_BE is not set
CONFIG_ESP_SIG_GEN_INTERLEAVED=y
# CONFIG_ESP_SIG_GEN_NON_INTERLEAVED is not set
CONFIG_ESP_SIG_GEN_PULL=y
# CONFIG_ESP_SIG_GEN_PUSH is not set
# end of ESP Signal Generator

#
# ESP TinyUSB Features
#
CONFIG_ENABLE_ESP_TINYUSB_FEATURES=y
CONFIG_ESP_TINYUSB_DEBUG_LEVEL=0
CONFIG_USE_SYNOPSYS_DWC2_DRIVER=y

#
# TinyUSB task configuration
#
CONFIG_ESP_TINYUSB_TASK_PRIORITY=5
CONFIG_ESP_TINYUSB_TASK_STACK_SIZE=4096
# end of TinyUSB task configuration

#
# Descriptor configuration
#
CONFIG_ESP_TINYUSB_DESC_CUSTOM_VID=0xcafe
CONFIG_ESP_TINYUSB_DESC_CUSTOM_PID=0x4011
CONFIG_ESP_TINYUSB_DESC_BCD_DEVICE=0x0100
CONFIG_ESP_TINYUSB_DESC_MANUFACTURER_STRING="Espressif Systems"
CONFIG_ESP_TINYUSB_DESC_PRODUCT_STRING="Espressif Device"
CONFIG_ESP_TINYUSB_DESC_SERIAL_STRING="123456"
CONFIG_ESP_TINYUSB_DESC_AUDIO_STRING="Espressif Audio (UAC2) Device"
# end of Descriptor configuration

#
# Audio Device Class (UAC2)
#
CONFIG_ESP_TINYUSB_AUDIO_ENABLED=y
CONFIG_ESP_TINYUSB_AUDIO_SAMPLE_RATE=48000
# CONFIG_ESP_AUDIO_16_BIT is not set
CONFIG_ESP_AUDIO_24_BIT=y
# CONFIG_ESP_AUDIO_1_CH is not set
CONFIG_ESP_AUDIO_2_CH=y
# CONFIG_ESP_AUDIO_4_CH is not set
CONFIG_AUDIO_BYTES_PER_SAMPLE=3
CONFIG_AUDIO_CHANNELS=2
# end of Audio Device Class (UAC2)

#
# Communication Device Class (CDC)
#
# CONFIG_ESP_TINYUSB_CDC_ENABLED is not set
# end of Communication Device Class (CDC)

#
# USB Network Class (ECM)
#
# CONFIG_ESP_TINYUSB_NET_ENABLED is not set
# end of USB Network Class (ECM)
# end of ESP TinyUSB Features
# end of Component config
```
